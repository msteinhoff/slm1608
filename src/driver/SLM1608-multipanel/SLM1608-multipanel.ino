// -----------------------------------------------------------------------------
// PORTD: Data Bus
// Digital  0 = PORTD 0
// reserved for serial

// Digital  1 = PORTD 1
// reserved for serial

// Digital  2 = PORTD 2
#define PIN_RED (1<<2)

// Digital  3 = PORTD 3
#define PIN_GREEN (1<<3)

// Digital  4 = PORTD 4
#define PIN_BLUE (1<<4)

// Digital  5 = PORTD 5
#define PIN_CLOCK (1<<5)

// Digital  6 = PORTD 6
#define PIN_BRIGHT (1<<6)

// Digital  7 = PORTD 7
#define PIN_RESET (1<<7)

// -----------------------------------------------------------------------------
// PORTB: Select lines
// Digital  8 = PORTB 0
// not used

// Digital  9 = PORTB 1
#define PIN_SELECT1 (1<<1)

// Digital 10 = PORTB 2
#define PIN_SELECT2 (1<<2)

// Digital 11 = PORTB 3
#define PIN_SELECT3 (1<<3)

// Digital 12 = PORTB 4
#define PIN_SELECT4 (1<<4)

// Digital 13 = PORTB 5
// not used

// -----------------------------------------------------------------------------
#define ROWS 16
#define COLS 16
#define PANELS 4

const int panelSelectPin[] = {
  PIN_SELECT1,
  PIN_SELECT2,
  PIN_SELECT3,
  PIN_SELECT4
};

// 0x01: green
// 0x02: red
byte framebuffer[] = {
  0x01, 0x01, 0x01, 0x01, 0x01, 0x01, 0x01, 0x00, 0x00, 0x01, 0x01, 0x01,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 0x01,
  0x01, 0x00, 0x00, 0x00, 0x00, 0x00, 0x00, 0x00, 0x00, 0x00, 0x00, 0x00,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 0x01,
  0x01, 0x00, 0x02, 0x02, 0x02, 0x02, 0x02, 0x02, 0x02, 0x02, 0x02, 0x02,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 0x01,
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  0x01, 0x01, 0x01, 0x01, 0x01, 0x01, 0x01, 0x01, 0x01, 0x01, 0x01, 0x01,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 0x01
};

int rowOffset = 0;
int panelOffset = 0;
int colOffset = 0;
int panel = 0;
int row = 0;
int col = 0;
byte datamask = B00000000;
int pixelCounter = 0;

void setup() {
  initializePins();
  initializePanels();
  redrawPanels();
  setupSerial();
}

void initializePins() {
  DDRD |= (PIN_RED | PIN_GREEN | PIN_CLOCK | PIN_BRIGHT | PIN_RESET);
  DDRB |= (PIN_SELECT1 | PIN_SELECT2 | PIN_SELECT3 | PIN_SELECT4);
  PORTD = B00000000;
  PORTB = B00000000;
}

void initializePanels() {
  PORTD |= (PIN_RESET | PIN_BRIGHT);
  PORTD &= ~(PIN_RESET | PIN_BRIGHT);
}

void setupSerial() {
  Serial.begin(115200);
  Serial.println("Ready");
}

// TODO http://forum.arduino.cc/index.php?topic=396450

void loop() {
  if(Serial.available()) {
    updateFramebufferFromSerial();
  }
  redrawPanels();
}

void updateFramebufferFromSerial() {
  char inByte = Serial.read();
  switch(inByte) {
    case 'i':
      reset();
      Serial.print("reset");
      break;
    case 'o':
      update(0x00);
      break;
    case 'g':
      update(0x01);
      break;
    case 'r':
      update(0x02);
      break;
    case 'y':
      update(0x03);
      break;
    default:
      break;
  }
}

void reset() {
  pixelCounter = 0;
  for(int i = 0; i < 1024; i++) {
    framebuffer[i] = 0;
  }
}

void update(byte value) {
    framebuffer[pixelCounter] = value;
    pixelCounter++;
    if(pixelCounter >= 1024) {
      pixelCounter = 0;
    }
}

void redrawPanels() {
  // we write panel by panel in the outer loop and set each panels select line
  // to high while writing pixel data
  for(panel = 0; panel < PANELS; panel++) {
    PORTB |= panelSelectPin[panel];
    // next, we write each panels's pixel data
    // columns are written left to right
    // rows are written written top to bottom
    for(row = 0; row < ROWS; row++) {  
      for(col = 0; col < COLS; col++) {
        // we currently use a one-dimensional array to store the whole framebuffer
        // to get an individual pixel we have to calculate the following offsets
        rowOffset = row*(PANELS*COLS);
        panelOffset = panel*COLS;
        colOffset = rowOffset + panelOffset + col;
        // to write a pixel, first the data lines must be set (red and/or green
        // to high or low), then the clock must be set to high and again to low
        // to move the pixel data into the panels shift register. finally, we 
        // data lines are reset to low to avoid stale data.
        // 
        // to achieve consistent timing, the temporary variable datamask is used
        // this way, PORTD is modified only once to write both values.
        datamask = B00000000;
        if(framebuffer[colOffset] & 0x01) {
          datamask |= PIN_GREEN;
        }
        if(framebuffer[colOffset] & 0x02) {
          datamask |= PIN_RED;
        }
        PORTD |= datamask;
        PORTD |= PIN_CLOCK;
        PORTD &= ~PIN_CLOCK;
        PORTD &= ~(PIN_RED | PIN_GREEN);
      }
    }
    PORTB &= ~panelSelectPin[panel];
  }
}
