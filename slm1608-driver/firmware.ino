// -----------------------------------------------------------------------------
// PORTD: Data Bus
// Digital  0 = PORTD 0
// reserved for serial

// Digital  1 = PORTD 1
// reserved for serial

// Digital  2 = PORTD 2
#define PIN_RED (1<<2)

// Digital  3 = PORTD 3
#define PIN_GREEN (1<<3)

// Digital  4 = PORTD 4
#define PIN_BLUE (1<<4)

// Digital  5 = PORTD 5
#define PIN_CLOCK (1<<5)

// Digital  6 = PORTD 6
#define PIN_BRIGHT (1<<6)

// Digital  7 = PORTD 7
#define PIN_RESET (1<<7)

// -----------------------------------------------------------------------------
// PORTB: Select lines
// Digital  8 = PORTB 0
// not used

// Digital  9 = PORTB 1
#define PIN_SELECT1 (1<<1)

// Digital 10 = PORTB 2
#define PIN_SELECT2 (1<<2)

// Digital 11 = PORTB 3
#define PIN_SELECT3 (1<<3)

// Digital 12 = PORTB 4
#define PIN_SELECT4 (1<<4)

// Digital 13 = PORTB 5
// not used

// -----------------------------------------------------------------------------
#define ROWS 16
#define COLS 16
#define PANELS 4

// -----------------------------------------------------------------------------
#define FRAME_SIZE 256
#define START_MARKER 0x3C
#define END_MARKER 0x3E

const int panelSelectPin[] = {
  PIN_SELECT1,
  PIN_SELECT2,
  PIN_SELECT3,
  PIN_SELECT4
};

// 0x01: green
// 0x02: red
byte framebuffer[] = {
  0x01, 0x01, 0x01, 0x01, 0x01, 0x01, 0x01, 0x00, 0x00, 0x01, 0x01, 0x01,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 0x01,
  0x01, 0x00, 0x00, 0x00, 0x00, 0x00, 0x00, 0x00, 0x00, 0x00, 0x00, 0x00,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 0x01,
  0x01, 0x00, 0x02, 0x02, 0x02, 0x02, 0x02, 0x02, 0x02, 0x02, 0x02, 0x02,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 0x01,
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  0x01, 0x01, 0x01, 0x01, 0x01, 0x01, 0x01, 0x01, 0x01, 0x01, 0x01, 0x01,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 0x01
};

void setup() {
  initializePins();
  initializePanels();
  resetPanels();
  setupSerial();
}

void loop() {
  recvBytes();
  updateFramebuffer();
  writePanels();
}

void initializePins() {
  DDRD |= (PIN_RED | PIN_GREEN | PIN_CLOCK | PIN_BRIGHT | PIN_RESET);
  DDRB |= (PIN_SELECT1 | PIN_SELECT2 | PIN_SELECT3 | PIN_SELECT4);
  PORTD = B00000000;
  PORTB = B00000000;
}

void initializePanels() {
  PORTD |= (PIN_RESET | PIN_BRIGHT);
  PORTD &= ~(PIN_RESET | PIN_BRIGHT);
}

void setupSerial() {
  Serial.begin(115200);
  Serial.println("<Arduino is ready>");
}

void resetPanels() {
  static boolean isInitialized = false; 
  if(isInitialized) {
    return;
  }

  for(int panel = 0; panel < PANELS; panel++) {
    PORTB |= panelSelectPin[panel];
    for(int row = 0; row < ROWS; row++) {  
      for(int col = 0; col < COLS; col++) {
        PORTD = B00000000;
        PORTD |= PIN_CLOCK;
        PORTD &= ~PIN_CLOCK;
      }
    }
    PORTB &= ~panelSelectPin[panel];
  }

  isInitialized = true;
}

byte receivedBytes[FRAME_SIZE];
boolean recvInProgress = false;
boolean newData = false;

void recvBytes() {
  static int rbIdx = 0;
  byte rb;
  while(Serial.available() > 0 && newData == false) {
    rb = Serial.read();
    if(!recvInProgress) {
      // ignore all data until start marker is sent
      if(rb == START_MARKER) {
        recvInProgress = true;
        //Serial.println("beg");
      } else {
        Serial.println("unk");
      }
    } else {
      if(rb != END_MARKER) {
        // regular data flow
        if(rbIdx < FRAME_SIZE) {
          receivedBytes[rbIdx] = rb;
          rbIdx++;
        } else {
          // frame received but no expected end marker sent
          recvInProgress = false;
          rbIdx = 0;
          Serial.println("eof");
        }
      } else {
        // at this point the controller has sent everything
        if(rbIdx == FRAME_SIZE) {
          newData = true;
          //Serial.println("end");
        } else {
          // end marker received but the frame is incomplete
          Serial.println("eur");
          if (rbIdx<1000) Serial.print('0');
          if (rbIdx<100) Serial.print('0');
          if (rbIdx<10) Serial.print('0');
          Serial.println(rbIdx);
        }
        recvInProgress = false;
        rbIdx = 0;
      }
    }
  }
}

void updateFramebuffer() {
  if(!newData) {
    return;
  }

  for(int i = 0, fbidx = 0; i < FRAME_SIZE; i++) {
    framebuffer[fbidx] = 0x03 & (receivedBytes[i]>>6);
    fbidx++;
    framebuffer[fbidx] = 0x03 & (receivedBytes[i]>>4);
    fbidx++;
    framebuffer[fbidx] = 0x03 & (receivedBytes[i]>>2);
    fbidx++;
    framebuffer[fbidx] = 0x03 & (receivedBytes[i]>>0);
    fbidx++;
    receivedBytes[i] = 0;
  }

  newData = false;
}

void writePanels() {
  // we write panel by panel in the outer loop and set each panels select line
  // to high while writing pixel data
  for(int panel = 0; panel < PANELS; panel++) {
    PORTB |= panelSelectPin[panel];
    // next, we write each panels's pixel data
    // columns are written left to right
    // rows are written written top to bottom
    for(int row = 0; row < ROWS; row++) {  
      for(int col = 0; col < COLS; col++) {
        // we currently use a one-dimensional array to store the whole framebuffer
        // to get an individual pixel we have to calculate the following offsets
        int rowOffset = row*(PANELS*COLS);
        int panelOffset = panel*COLS;
        int colOffset = rowOffset + panelOffset + col;
        // to write a pixel, first the data lines must be set (red and/or green
        // to high or low), then the clock must be set to high and again to low
        // to move the pixel data into the panels shift register. finally, we 
        // data lines are reset to low to avoid stale data.
        // 
        // to achieve consistent timing, the temporary variable datamask is used
        // this way, PORTD is modified only once to write both values.
        byte datamask = B00000000;
        if(framebuffer[colOffset] & 0x01) {
          datamask |= PIN_GREEN;
        }
        if(framebuffer[colOffset] & 0x02) {
          datamask |= PIN_RED;
        }
        PORTD |= datamask;
        PORTD |= PIN_CLOCK;
        PORTD &= ~PIN_CLOCK;
        PORTD &= ~(PIN_RED | PIN_GREEN);
      }
    }
    PORTB &= ~panelSelectPin[panel];
  }
}

